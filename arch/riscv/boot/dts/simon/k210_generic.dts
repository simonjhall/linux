// SPDX-License-Identifier: GPL-2.0+
/*
 * Copyright (C) 2019-20 Sean Anderson <seanga2@gmail.com>
 * Copyright (C) 2020 Western Digital Corporation or its affiliates.
 */

/dts-v1/;

#include "k210.dtsi"

#include <dt-bindings/gpio/gpio.h>
#include <dt-bindings/input/input.h>

/ {
	model = "Simon FPGA";
	compatible = "canaan,kendryte-k210";

	chosen {
		bootargs = "console=ttyS0 root=/dev/ham_uart0 ro single";
		/*stdout-path = "serial0:115200n8";*/
	};
};
